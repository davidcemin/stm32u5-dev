## fronimo/drivers/Kconfig
```kconfig
# Drivers Kconfig

menu "Custom Drivers"

# Include sensor drivers
rsource "sensor/Kconfig"

# Include audio drivers
rsource "audio/Kconfig"

endmenu
```

## fronimo/drivers/audio/Kconfig
```kconfig
# STM32U5 MDF/ADF Audio Driver Configuration

config AUDIO_STM32_MDF
	bool "STM32 MDF (Multi-rate Digital Filter) driver"
	default y
	depends on SOC_FAMILY_STM32
	select AUDIO
	select DMA
	select CLOCK_CONTROL
	select PINCTRL
	help
	  Enable driver for STM32 MDF peripheral used for PDM microphones.
	  This peripheral provides hardware digital filtering and decimation
	  for PDM microphone inputs.

if AUDIO_STM32_MDF

config AUDIO_STM32_MDF_LOG_LEVEL
	int "STM32 MDF driver log level"
	depends on LOG
	default 3
	range 0 4
	help
	  Sets log level for STM32 MDF driver.
	  Levels are:
	  0 OFF, do not write
	  1 ERROR, only write SYS_LOG_ERR
	  2 WARNING, write SYS_LOG_WRN in addition to previous level
	  3 INFO, write SYS_LOG_INF in addition to previous level
	  4 DEBUG, write SYS_LOG_DBG in addition to previous level

config AUDIO_STM32_MDF_RX_BLOCK_COUNT
	int "RX block count"
	default 4
	help
	  Number of RX blocks for audio buffering.

config AUDIO_STM32_MDF_DMA_BUFFER_SIZE
	int "DMA buffer size in bytes"
	default 2048
	help
	  Size of DMA buffer for audio data transfer.

endif # AUDIO_STM32_MDF
```

## fronimo/drivers/audio/Kconfig.dmic_stm32_mdf
```kconfig
# STM32 MDF Digital Microphone configuration options

config DMIC_STM32_MDF
	bool "STM32 MDF Digital Microphone Driver"
	default y
	depends on SOC_FAMILY_STM32
	select USE_STM32_HAL_MDF
	help
	  Enable STM32 MDF (Multi-rate Digital Filter) Digital Microphone driver.
	  This driver supports PDM microphones connected to STM32 MDF peripheral.

if DMIC_STM32_MDF

config DMIC_STM32_MDF_DMA
	bool "STM32 MDF DMA support"
	default y
	help
	  Enable DMA support for STM32 MDF driver.

endif # DMIC_STM32_MDF
```

## fronimo/drivers/sensor/st/Kconfig
```kconfig
# ST Sensor Drivers Kconfig

# Include VL53L5CX driver
rsource "vl53l5cx/Kconfig"
```

## fronimo/drivers/sensor/st/vl53l5cx/Kconfig
```kconfig
# ST Microelectronics VL53L5CX Time-of-Flight sensor

# Copyright (c) 2025 David Cemin
# SPDX-License-Identifier: Apache-2.0

menuconfig VL53L5CX
	bool "VL53L5CX Time-of-Flight sensor"
	default y
	depends on DT_HAS_ST_VL53L5CX_ENABLED && I2C
	help
	  Enable driver for VL53L5CX I2C-based Time-of-Flight sensor.
	  This sensor provides multi-zone ranging with 8x8 or 4x4 resolution.

if VL53L5CX

choice VL53L5CX_TRIGGER_MODE
	prompt "Trigger mode"
	default VL53L5CX_TRIGGER_GLOBAL_THREAD
	help
	  Specify the type of triggering to be used by the driver.

config VL53L5CX_TRIGGER_NONE
	bool "No trigger"

config VL53L5CX_TRIGGER_GLOBAL_THREAD
	bool "Use global thread"
	depends on GPIO
	depends on $(dt_compat_any_has_prop,$(DT_COMPAT_ST_VL53L5CX),int-gpios)
	select VL53L5CX_TRIGGER

config VL53L5CX_TRIGGER_OWN_THREAD
	bool "Use own thread"
	depends on GPIO
	depends on $(dt_compat_any_has_prop,$(DT_COMPAT_ST_VL53L5CX),int-gpios)
	select VL53L5CX_TRIGGER

endchoice # VL53L5CX_TRIGGER_MODE

config VL53L5CX_TRIGGER
	bool

config VL53L5CX_THREAD_PRIORITY
	int "Thread priority"
	depends on VL53L5CX_TRIGGER_OWN_THREAD
	default 10
	help
	  Priority of thread used by the driver to handle interrupts.

config VL53L5CX_THREAD_STACK_SIZE
	int "Thread stack size"
	depends on VL53L5CX_TRIGGER_OWN_THREAD
	default 1024
	help
	  Stack size of thread used by the driver to handle interrupts.

config VL53L5CX_DEFAULT_RESOLUTION
	int "Default resolution"
	default 16
	range 16 64
	help
	  Default zone resolution: 16 for 4x4, 64 for 8x8.

config VL53L5CX_DEFAULT_FREQUENCY
	int "Default ranging frequency in Hz"
	default 10
	range 1 60
	help
	  Default ranging frequency in Hz.

endif # VL53L5CX
```

## sensors/drivers/Kconfig
```kconfig
# Drivers Kconfig

menu "Custom Drivers"

# Include sensor drivers
rsource "sensor/Kconfig"

# Include audio drivers
rsource "audio/Kconfig.dmic_stm32_mdf"

endmenu
```

## sensors/drivers/sensor/Kconfig
```kconfig
# Sensor Drivers Kconfig

menu "Sensor Drivers"

# Include ST sensor drivers
rsource "st/Kconfig"

endmenu
```

## wifi/drivers/Kconfig
```kconfig
# Copyright (c) 2025 David Cemin
# SPDX-License-Identifier: Apache-2.0

source "$(dirname ${BASH_SOURCE[0]})/wifi/Kconfig"
```

## wifi/drivers/wifi/Kconfig
```kconfig
# Copyright (c) 2025 David Cemin
# SPDX-License-Identifier: Apache-2.0

menuconfig WIFI_DRIVERS
		bool "WiFi Drivers"
		depends on WIFI
		help
			Enable WiFi drivers

if WIFI_DRIVERS

# Include our custom EMW3080 driver only
rsource "emw3080/Kconfig"

endif # WIFI_DRIVERS
```

## wifi/drivers/wifi/emw3080/Kconfig
```kconfig
# EMW3080 Wi-Fi driver configuration options

menuconfig EMW3080
	bool "EMW3080 driver support"
	default y
	depends on WIFI && DT_HAS_MXCHIP_EMW3080_ENABLED
	depends on SPI
	depends on GPIO
	help
	  Enable MXCHIP EMW3080 WiFi driver.

if EMW3080

config EMW3080_SPI_LOG_LEVEL
	int "EMW3080 SPI log level"
	range 0 4
	default 2
	help
	  Per-module log level for the emw3080_spi driver.
	  0=NONE, 1=ERR, 2=WRN, 3=INF, 4=DBG.

config EMW3080_LOG_LEVEL
	int "EMW3080 core log level"
	range 0 4
	default 2
	help
	  Per-module log level for the emw3080 core driver.
	  0=NONE, 1=ERR, 2=WRN, 3=INF, 4=DBG.

config EMW3080_INIT_LOG_LEVEL
	int "EMW3080 init log level"
	range 0 4
	default 2
	help
	  Per-module log level for emw3080_init.
	  0=NONE, 1=ERR, 2=WRN, 3=INF, 4=DBG.

config EMW3080_SPI_HOLD_ON_CS
	bool "Keep CS asserted across header+payload read"
	default y
	help
	  When enabled, the driver keeps chip-select asserted while reading
	  the header and then the payload in two back-to-back SPI transfers.
	  Some modules require continuous CS for a full frame.

config EMW3080_SPI_MODE3
		bool "Use SPI Mode 3 (CPOL=1, CPHA=1)"
		default n
		help
			Force SPI mode 3 if the target hardware requires it. Normally the
			default is mode 0; this overrides it in the driver unless DTS sets it.

config EMW3080_SPI_FREQ_HZ
		int "SPI frequency (Hz)"
		default 8000000
		range 500000 20000000
		help
			Override SPI frequency for EMW3080 if DTS frequency is not set.

config EMW3080_RX_STACK_SIZE
	int "Stack size for EMW3080 RX handler"
	default 1024
	help
	  Stack size for the EMW3080 RX handler thread.

config EMW3080_RX_PRIO
	int "Priority for EMW3080 RX handler"
	default 7
	help
	  Priority for the EMW3080 RX handler thread.

endif # EMW3080
```
